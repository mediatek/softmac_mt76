## mt7999/Kconfig
```kconfig
# SPDX-License-Identifier: BSD-3-Clause-Clear
config MT7999E
	tristate "MediaTek MT7999 (PCIe) support"
	select MT76_CONNAC_LIB
	select WANT_DEV_COREDUMP
	depends on MAC80211
	depends on PCI
	help
	  This adds support for MT7999-based wireless PCIe devices,
	  which support concurrent tri-band operation at 6GHz, 5GHz,
	  and 2.4GHz IEEE 802.11be 4x4:4SS 4096-QAM, 320MHz channels.

	  To compile this driver as a module, choose M here.

config MT7999_NPU
	bool "MT7999 (PCIe) NPU support"
	depends on MT7999E
	depends on NET_AIROHA_NPU=y || MT7999E=NET_AIROHA_NPU
	select MT76_NPU
	default n
```
